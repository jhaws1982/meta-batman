## conf/layer.conf
```bitbake
# Specify OE-Core versions this is compatible with
LAYERSERIES_COMPAT_batman = " \
			jethro \
			krogoth \
			morty \
			pyro \
			rocko \
			sumo \
			thud \
			warrior \
			zeus \
			dunfell \
			gatesgarth \
			"

# We have a conf and classes directory, add to BBPATH
BBPATH .= ":${LAYERDIR}"

# We have recipes-* directories, add to BBFILES
BBFILES += "${LAYERDIR}/recipes-*/*.bb \
	${LAYERDIR}/recipes-*/*.bbappend \
	${LAYERDIR}/recipes-*/*/*.bbappend"

BBFILE_COLLECTIONS += "batman"
BBFILE_PATTERN_batman = "^${LAYERDIR}/"
BBFILE_PRIORITY_batman = "9"

KERNEL_MODULE_AUTOLOAD += " batman-adv"
```
